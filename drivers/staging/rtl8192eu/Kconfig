## drivers/staging/rtl8192eu/Kconfig
```kconfig
config R8192EU
	tristate "Realtek RTL8192EU Wireless LAN NIC driver"
	depends on WLAN && USB
	select WIRELESS_EXT
	select WEXT_PRIV
	---help---
	This option adds the Realtek RTL8192EU USB device.
	If built as a module, it will be called r8192eu.

if R8192EU

config 8192EU_AP_MODE
	bool "Realtek RTL8192EU AP mode"
	default y
	---help---
	This option enables Access Point mode. Unless you know that your system
	will never be used as an AP, or the target system has limited memory,
	"Y" should be selected.

endif
```
